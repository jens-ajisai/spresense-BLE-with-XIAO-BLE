## firmware/seeedstudio_xiao_nrf52840/Kconfig
```kconfig
# Seeedstudio XIAO NRF52840 board configuration

if BOARD_SEEEDSTUDIO_XIAO_NRF52840

config BOARD_ENABLE_DCDC
	bool "Enable DCDC mode"
	select SOC_DCDC_NRF52X
	default y

config BOARD_HAS_XIAO_BLE_BOOTLOADER
	bool "Board has XIAO BLE bootloader"
	default y
	help
	  If selected, applications are linked so that they can be loaded by Nordic
	  XIAO BLE bootloader and do not overwrite the existing softdevice.

endif # BOARD_SEEEDSTUDIO_XIAO_NRF52840
```

## firmware/seeedstudio_xiao_nrf52840/Kconfig.board
```kconfig
# Seeedstudio XIAO NRF52840 board configuration

config BOARD_SEEEDSTUDIO_XIAO_NRF52840
	bool "Seeedstudio XIAO NRF52840"
	depends on SOC_NRF52840_QIAA
```

## firmware/seeedstudio_xiao_nrf52840/Kconfig.defconfig
```kconfig
# Seeedstudio XIAO NRF52840 board configuration

if BOARD_SEEEDSTUDIO_XIAO_NRF52840

config BOARD
	default "seeedstudio_xiao_nrf52840"

# To keep the pre-installed bootloader and softdevice as is,
# link the application at flash address 0x27000 as descibed here
# https://github.com/adafruit/Adafruit_nRF52_Bootloader

# Manually override FLASH_LOAD_OFFEST to link the application
# correctly, after the softdevice.
# We do not use this pre-installed softdevice, but flash our own.

config FLASH_LOAD_OFFSET
	default 0x27000
	depends on BOARD_HAS_XIAO_BLE_BOOTLOADER && !USE_DT_CODE_PARTITION

if USB_DEVICE_STACK

# Enable UART driver, needed for CDC ACM
config SERIAL
	default y

endif # USB_DEVICE_STACK

config BT_CTLR
	default BT

endif # BOARD_SEEEDSTUDIO_XIAO_NRF52840
```

## firmware/seeedstudio_xiao_nrf52840/seeedstudio_xiao_nrf52840_defconfig
```kconfig
CONFIG_SOC_SERIES_NRF52X=y
CONFIG_SOC_NRF52840_QIAA=y
CONFIG_BOARD_SEEEDSTUDIO_XIAO_NRF52840=y

# Enable MPU
CONFIG_ARM_MPU=y

# Enable hardware stack protection
CONFIG_HW_STACK_PROTECTION=y

# enable GPIO
CONFIG_GPIO=y

# additional board options
CONFIG_GPIO_AS_PINRESET=y
```
